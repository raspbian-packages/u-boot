## board/solidrun/mx6cuboxi/Kconfig
```kconfig
if TARGET_MX6CUBOXI

config SYS_BOARD
	default "mx6cuboxi"

config SYS_VENDOR
	default "solidrun"

config SYS_CONFIG_NAME
	default "mx6cuboxi"

config I4X4_RAM
	bool "4GB ram support for cubox i4x4 (will break cubox i4)"
	default n

endif
```

## configs/Bananapro_defconfig
```kconfig
CONFIG_SPL=y
CONFIG_SYS_EXTRA_OPTIONS="BANANAPRO,AXP209_POWER,SUNXI_GMAC,RGMII,MACPWR=SUNXI_GPH(23),AHCI,USB_EHCI,SUNXI_USB_VBUS0_GPIO=SUNXI_GPH(0),SUNXI_USB_VBUS1_GPIO=SUNXI_GPH(1)"
CONFIG_FDTFILE="sun7i-a20-bananapro.dtb"
+S:CONFIG_ARM=y
+S:CONFIG_TARGET_SUN7I=y
```
